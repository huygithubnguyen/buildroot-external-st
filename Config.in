## Config.in
```kconfig
menu "External STM32MP157F-DK2 Packages"

source "$BR2_EXTERNAL_ST_PATH/package/qt5-ipc-system/Config.in"
source "$BR2_EXTERNAL_ST_PATH/package/qt-bike-gui/Config.in"

endmenu
```

## package/qt-bike-computer/Config.in
```kconfig
config BR2_PACKAGE_QT_BIKE_COMPUTER
    bool "qt-bike-computer"
    help
      Qt-based bike computer application for STM32MP157F-DK2
      
      Features:
      - Real-time speed and distance tracking
      - GPS integration and route display
      - Touch screen interface with Qt5
      - IPC integration for system communication
```

## package/qt-bike-gui/Config.in
```kconfig
config BR2_PACKAGE_QT_BIKE_GUI
	bool "qt-bike-gui"
	depends on BR2_PACKAGE_QT5BASE
	depends on BR2_PACKAGE_QT5DECLARATIVE
	depends on BR2_PACKAGE_QT5MULTIMEDIA
	depends on BR2_PACKAGE_QT5SVG
	depends on BR2_PACKAGE_QT5_IPC_SYSTEM
	select BR2_PACKAGE_QT5BASE
	select BR2_PACKAGE_QT5DECLARATIVE
	select BR2_PACKAGE_QT5MULTIMEDIA
	select BR2_PACKAGE_QT5SVG
	select BR2_PACKAGE_QT5_IPC_SYSTEM
	help
	  Qt5 Bike Computer GUI for STM32MP157F-DK2 embedded platform.
	  Features include:
	  - Real-time GPS display and navigation
	  - Sensor data visualization (speed, cadence, heart rate)
	  - ANT+ device integration
	  - Multimedia support for alerts and sounds
	  - SVG-based scalable graphics
	  - IPC communication with backend services
	  - EGLFS hardware acceleration
	  - Touch screen interface

	  This application provides a professional bike computer interface
	  optimized for the STM32MP157F-DK2 hardware.

if BR2_PACKAGE_QT_BIKE_GUI

config BR2_PACKAGE_QT_BIKE_GUI_DEMO_MODE
	bool "Enable demo mode"
	help
	  Enable demo mode with simulated data for testing and demonstration
	  purposes. When enabled, the application will generate fake GPS,
	  sensor, and ANT+ data instead of requiring real hardware.

config BR2_PACKAGE_QT_BIKE_GUI_BUILD_TESTS
	bool "Build unit tests"
	help
	  Build and install unit tests for qt-bike-gui. Tests will be
	  installed in /usr/lib/qt-bike-gui/tests and can be run with
	  the qt-bike-gui-test command.

config BR2_PACKAGE_QT_BIKE_GUI_DEBUG
	bool "Enable debug build"
	help
	  Enable debug symbols and logging for qt-bike-gui.
	  Useful for development and troubleshooting.

endif

comment "qt-bike-gui needs Qt5 components and qt5-ipc-system"
	depends on !BR2_PACKAGE_QT5BASE || !BR2_PACKAGE_QT5DECLARATIVE || \
		!BR2_PACKAGE_QT5MULTIMEDIA || !BR2_PACKAGE_QT5SVG || \
		!BR2_PACKAGE_QT5_IPC_SYSTEM
```

## package/qt-demo-simple/Config.in
```kconfig
config BR2_PACKAGE_QT_DEMO_SIMPLE
	bool "qt-demo-simple"
	depends on BR2_PACKAGE_QT5
	depends on BR2_PACKAGE_JSON_C
	depends on BR2_PACKAGE_QT5_IPC_SYSTEM
	select BR2_PACKAGE_QT5BASE_WIDGETS
	help
	  Qt5 Demo Simple application for STM32MP157F-DK2
	  Demonstrates Qt5 + IPC integration with comprehensive testing
	  including touch events, display updates, status messages,
	  and JSON parsing capabilities. Requires qt5-ipc-system package.
	  
	  Features:
	  - Console-based Qt5 application
	  - IPC client integration with qt5-ipc-system
	  - Touch coordinate testing
	  - Display parameter updates
	  - Service status monitoring
	  - JSON message parsing and validation
	  - Performance metrics and queue monitoring
	  
	  This package provides a working example of Qt5 application
	  development for embedded Linux systems with IPC communication.
	  Requires the IPC daemon service from qt5-ipc-system package.

comment "qt-demo-simple needs Qt5, json-c, and qt5-ipc-system"
	depends on !BR2_PACKAGE_QT5 || !BR2_PACKAGE_JSON_C || !BR2_PACKAGE_QT5_IPC_SYSTEM
```

## package/qt5-ipc-system/Config.in
```kconfig
config BR2_PACKAGE_QT5_IPC_SYSTEM
	bool "qt5-ipc-system"
	depends on BR2_USE_MMU
	depends on BR2_INSTALL_LIBSTDCPP
	depends on BR2_TOOLCHAIN_HAS_THREADS
	select BR2_PACKAGE_JSON_C
	select BR2_PACKAGE_QT5BASE
	select BR2_PACKAGE_QT5BASE_WIDGETS
	select BR2_PACKAGE_QT5DECLARATIVE
	help
	  Qt5 IPC System provides inter-process communication for embedded
	  applications on STM32MP157F-DK2. Includes:
	  - Core IPC library (C)
	  - Qt5 wrapper library (C++)
	  - IPC daemon for service management
	  - JSON-based message protocol
	  - Socket-based communication

	  This package is required by qt-bike-gui and other Qt5 applications
	  that need IPC communication on the STM32MP157F-DK2 platform.

if BR2_PACKAGE_QT5_IPC_SYSTEM

config BR2_PACKAGE_QT5_IPC_SYSTEM_DEBUG
	bool "Enable debug build"
	help
	  Enable debug symbols and logging for qt5-ipc-system.
	  Useful for development and troubleshooting.

endif

comment "qt5-ipc-system needs toolchain with MMU, C++ and threads"
	depends on !BR2_USE_MMU || !BR2_INSTALL_LIBSTDCPP || \
		!BR2_TOOLCHAIN_HAS_THREADS
```

## package/qt_demo_simple/Config.in
```kconfig
config BR2_PACKAGE_QT_DEMO_SIMPLE
    bool "qt-demo-simple"
    help
      Simple Qt5 demo application for STM32MP157F-DK2
      
      Basic Qt5 application demonstrating:
      - Window creation and event handling
      - Touch input integration
      - Graphics rendering
      - Cross-platform compatibility
```
